#define VERSION_MACRO
macro_ver: macro_ver {
compatible = "zmk,behavior-macro";
label = "macro_ver";
#binding-cells = <0>;
bindings = <&kp N2>, <&kp N0>, <&kp N2>, <&kp N4>, <&kp N0>, <&kp N1>, <&kp N1>, <&kp N7>, <&kp MINUS>, <&kp M>, <&kp A>, <&kp C>, <&kp MINUS>, <&kp N9>, <&kp N4>, <&kp N3>, <&kp C>, <&kp N2>, <&kp N9>, <&kp N5>, <&kp RET>;
};
